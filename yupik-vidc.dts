// SPDX-License-Identifier: BSD-3-Clause
/*
 * Copyright (c) Qualcomm Technologies, Inc. and/or its subsidiaries.
 */

/dts-v1/;
/plugin/;

#include <dt-bindings/interrupt-controller/arm-gic.h>
#include <dt-bindings/clock/qcom,gcc-sc7280.h>
#include <dt-bindings/interconnect/qcom,yupik.h>
#include <dt-bindings/clock/qcom,videocc-sc7280.h>
#include "yupik-vidc.dtsi"

/ {
	model = "Qualcomm Technologies, Inc. YUPIK";
	compatible = "qcom,yupik-iot";
	qcom,msm-id = <497 0x10000>, <498 0x10000>, <575 0x10000>, <576 0x10000>;
	qcom,board-id = <0 0>;
};
